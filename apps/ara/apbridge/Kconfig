## apps/ara/apbridge/Kconfig
```kconfig
#
# For a description of the syntax of this configuration file,
# see misc/tools/kconfig-language.txt.
#

config APBRIDGE
	bool "APBridge"
	select GREYBUS
	default n

config APBRIDGE_UNIPRO
	bool "Enable UniPro layer"
	depends on APBRIDGE
	default y
```

## apps/ara/qdebug/Kconfig
```kconfig
#
# For a description of the syntax of this configuration file,
# see misc/tools/kconfig-language.txt.
#
# Copyright (C) 2014 Google, Inc.
# Google Confidential/Restricted
#

config ARA_SVC_QDEBUG
	bool "Ara SVC qdebug"
	default n
	depends on ARCH_BOARD_ARA_BDB_SVC || ARCH_BOARD_ARA_ENDO_SVC
	---help---
		Enable the Ara Debug program. Controls the debug output messages

if ARA_SVC_DBUG

config ARA_SVC_QDEBUG_PROGNAME
	string "Program name"
	default "qdebug"
	depends on BUILD_KERNEL
	---help---
		This is the name of the program that will be used when the
		NSH ELF program is installed.

endif
```

## apps/ara/spi/Kconfig
```kconfig
#
# For a description of the syntax of this configuration file,
# see misc/tools/kconfig-language.txt.
#

config ARA_SPI_BITBANG_TEST
	bool "Ara SPI bit-bang device driver test program"
	default n if !DEBUG
	default y if DEBUG
	depends on ARCH_CHIP_TSB && !GREYBUS_SPI_PHY
	---help---
		Enable the SPI bitbang test program.


if ARA_SPI_BITBANG_TEST

config ARA_SPI_BITBANG_TEST_PROGNAME
	string "Program name"
	default "spi_test"
	depends on BUILD_KERNEL
	---help---
		This is the name of the program that will be used when the
		NSH ELF program is installed.

endif
```

## nuttx/configs/ara/svc/Kconfig
```kconfig
#
# For a description of the syntax of this configuration file,
# see misc/tools/kconfig-language.txt.
#

choice
	prompt "Select a route config"
config SVC_ROUTE_DEFAULT
	bool "APB1 to APB2"
config SVC_ROUTE_SPRING6_APB2
	bool "AP Module to APB2"
config SVC_ROUTE_APB1_APB2_APB3
	bool "APB1 to APB2 and APB3"
config SVC_ROUTE_APB1_APB2_SPRING7
	bool "APB1 to APB2 and Camera Module"
endchoice
```
